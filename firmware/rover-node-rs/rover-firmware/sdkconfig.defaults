## firmware/rover-node-rs/rover-firmware/sdkconfig.defaults
```kconfig
CONFIG_ESP_MAIN_TASK_STACK_SIZE=20480
# PSRAM (WROVER) — needed later for camera framebuffers
CONFIG_ESP32_SPIRAM_SUPPORT=y
CONFIG_SPIRAM_USE_MALLOC=y
# OTA rollback support
CONFIG_BOOTLOADER_APP_ROLLBACK_ENABLE=y
```
